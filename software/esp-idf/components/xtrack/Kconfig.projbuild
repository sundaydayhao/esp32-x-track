## software/esp-idf/components/xtrack/Kconfig.projbuild
```kconfig
menu "X-Track / LCKFB SZP ESP32-S3"
config XTRACK_GPS_BAUD
    int "GPS UART baud rate"
    default 9600
    range 1200 460800
config XTRACK_GPS_RX
    int "GPS RX GPIO (connect module TX)"
    default 10
    range 10 11
config XTRACK_GPS_TX
    int "GPS TX GPIO (connect module RX)"
    default 11
    range 10 11
config XTRACK_GPS_MAX_AGE_MS
    int "Maximum age of a usable position (ms)"
    default 2500
    range 1000 10000
config XTRACK_MAX17048
    bool "External MAX17048 battery gauge on I2C"
    default n
    help
        Standard SZP board has no battery gauge/charger. Enable only with
        an external battery/power system and MAX17048 at 0x36.
config XTRACK_ENV_SENSORS
    bool "External QMC5883L + BMP280 + SHT3x sensors on I2C"
    default n
    help
        Probe each device separately. Unavailable measurements are not fabricated.
config XTRACK_TOUCH_SWAP_XY
    bool "Touch swap X/Y"
    default y
config XTRACK_TOUCH_MIRROR_X
    bool "Touch mirror X"
    default y
config XTRACK_TOUCH_MIRROR_Y
    bool "Touch mirror Y"
    default n
endmenu
```

## software/esp-idf/sdkconfig.defaults
```kconfig
CONFIG_IDF_TARGET="esp32s3"
CONFIG_ESPTOOLPY_FLASHSIZE_16MB=y
CONFIG_ESPTOOLPY_FLASHMODE_QIO=y
CONFIG_ESPTOOLPY_FLASHFREQ_80M=y
CONFIG_SPIRAM=y
CONFIG_SPIRAM_MODE_OCT=y
CONFIG_SPIRAM_SPEED_80M=y
CONFIG_SPIRAM_USE_MALLOC=y
CONFIG_SPIRAM_MALLOC_ALWAYSINTERNAL=16384
CONFIG_SPIRAM_MALLOC_RESERVE_INTERNAL=65536
CONFIG_ESP_DEFAULT_CPU_FREQ_MHZ_240=y
CONFIG_FREERTOS_HZ=1000
CONFIG_ESP_MAIN_TASK_STACK_SIZE=12288
CONFIG_PARTITION_TABLE_CUSTOM=y
CONFIG_PARTITION_TABLE_CUSTOM_FILENAME="partitions.csv"
CONFIG_FATFS_LFN_HEAP=y
CONFIG_FATFS_MAX_LFN=255
CONFIG_FATFS_FS_LOCK=8
CONFIG_FATFS_TIMEOUT_MS=2000
CONFIG_LV_COLOR_DEPTH_16=y
CONFIG_LV_COLOR_16_SWAP=y
CONFIG_LV_MEM_CUSTOM=y
CONFIG_LV_USE_LOG=y
CONFIG_LV_LOG_LEVEL_WARN=y
CONFIG_LV_FONT_MONTSERRAT_14=y
CONFIG_LV_FONT_MONTSERRAT_16=y
CONFIG_LV_FONT_MONTSERRAT_20=y
CONFIG_LV_FONT_MONTSERRAT_24=y
CONFIG_LV_USE_USER_DATA=y
CONFIG_LV_USE_PNG=y
```
